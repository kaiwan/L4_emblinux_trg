## rpi64_demos_builddir/conf/bblayers.conf
```bitbake
# POKY_BBLAYERS_CONF_VERSION is increased each time build/conf/bblayers.conf
# changes incompatibly
POKY_BBLAYERS_CONF_VERSION = "2"

BBPATH = "${TOPDIR}"
BBFILES ?= ""

BBLAYERS ?= " \
  /opt/yocto/poky/meta \
  /opt/yocto/poky/meta-poky \
  /opt/yocto/poky/meta-yocto-bsp \
  /opt/yocto/poky/meta-raspberrypi \
  /opt/yocto/poky/meta-openembedded/meta-oe \
  /opt/yocto/poky/build_rpi/meta-myprj \
  /opt/yocto/poky/build_rpi/meta-mybsp \
  "
```

## rpi64_demos_builddir/meta-mybsp/conf/layer.conf
```bitbake
# We have a conf and classes directory, add to BBPATH
BBPATH .= ":${LAYERDIR}"

# We have recipes-* directories, add to BBFILES
BBFILES += "${LAYERDIR}/recipes-*/*/*.bb \
${LAYERDIR}/recipes-*/*/*.bbappend"

BBFILE_COLLECTIONS += "mybsp"
BBFILE_PATTERN_mybsp = "^${LAYERDIR}/"
BBFILE_PRIORITY_mybsp = "10"

LAYER_DEPENDS_mybsp = "core"
## TIP: UPDATE with later Yocto release names!
LAYERSERIES_COMPAT_mybsp = "thud warrior zeus dunfell"
```

## rpi64_demos_builddir/meta-myprj/conf/layer.conf
```bitbake
# We have a conf and classes directory, add to BBPATH
BBPATH .= ":${LAYERDIR}"

# We have recipes-* directories, add to BBFILES
BBFILES += "${LAYERDIR}/recipes-*/*/*.bb \
${LAYERDIR}/recipes-*/*/*.bbappend"

BBFILE_COLLECTIONS += "myprj"
BBFILE_PATTERN_myprj = "^${LAYERDIR}/"
BBFILE_PRIORITY_myprj = "10"

LAYER_DEPENDS_myprj = "core"
## TIP: UPDATE with later Yocto release names!
LAYERSERIES_COMPAT_myprj = "thud warrior zeus dunfell"
```

## yocto/qemuarm64_demos_builddir/conf/bblayers.conf
```bitbake
# POKY_BBLAYERS_CONF_VERSION is increased each time build/conf/bblayers.conf
# changes incompatibly
POKY_BBLAYERS_CONF_VERSION = "2"

BBPATH = "${TOPDIR}"
BBFILES ?= ""

BBLAYERS ?= " \
  /big/yocto_qarm64_nov22/poky/meta \
  /big/yocto_qarm64_nov22/poky/meta-poky \
  /big/yocto_qarm64_nov22/poky/meta-yocto-bsp \
  /big/yocto_qarm64_nov22/poky/meta-openembedded/meta-oe \
  /big/yocto_qarm64_nov22/poky/build_qemuarm64/meta-myprj \
  /big/yocto_qarm64_nov22/poky/build_qemuarm64/meta-helloworld \
  /big/yocto_qarm64_nov22/poky/build_qemuarm64/meta-myapps \
  /big/yocto_qarm64_nov22/poky/build_qemuarm64/meta-kmods \
  /big/yocto_qarm64_nov22/poky/meta-qt5 \
  /big/yocto_qarm64_nov22/poky/build_qemuarm64/meta-demo-qt5-app \
  /big/yocto_qarm64_nov22/poky/build_qemuarm64/meta-psplash \
  "
```

## yocto/qemuarm64_demos_builddir/meta-autotools-helloworld/conf/layer.conf
```bitbake
# We have a conf and classes directory, add to BBPATH
BBPATH .= ":${LAYERDIR}"

# We have recipes-* directories, add to BBFILES
BBFILES += "${LAYERDIR}/recipes-*/*/*.bb \
            ${LAYERDIR}/recipes-*/*/*.bbappend"

BBFILE_COLLECTIONS += "meta-autotools-helloworld"
BBFILE_PATTERN_meta-autotools-helloworld = "^${LAYERDIR}/"
BBFILE_PRIORITY_meta-autotools-helloworld = "6"

LAYERDEPENDS_meta-autotools-helloworld = "core"
LAYERSERIES_COMPAT_meta-autotools-helloworld = "dunfell"
```

## yocto/qemuarm64_demos_builddir/meta-demo-qt5-app/conf/layer.conf
```bitbake
# We have a conf and classes directory, add to BBPATH
BBPATH .= ":${LAYERDIR}"

# We have recipes-* directories, add to BBFILES
BBFILES += "${LAYERDIR}/recipes-*/*/*.bb \
${LAYERDIR}/recipes-*/*/*.bbappend"

BBFILE_COLLECTIONS += "qt1"
BBFILE_PATTERN_qt1 = "^${LAYERDIR}/"
BBFILE_PRIORITY_qt1 = "10"

LAYER_DEPENDS_qt1 = "core"
## TIP: UPDATE with later Yocto release names!
# ref: https://wiki.yoctoproject.org/wiki/Releases
# FIXME :: UPDATE the release names as required!
LAYERSERIES_COMPAT_qt1 = "honister dunfell hardknott"
```

## yocto/qemuarm64_demos_builddir/meta-kmods/conf/layer.conf
```bitbake
# We have a conf and classes directory, add to BBPATH
BBPATH .= ":${LAYERDIR}"

# We have recipes-* directories, add to BBFILES
BBFILES += "${LAYERDIR}/recipes-*/*/*.bb \
            ${LAYERDIR}/recipes-*/*/*.bbappend"

BBFILE_COLLECTIONS += "meta-kmods"
BBFILE_PATTERN_meta-kmods = "^${LAYERDIR}/"
BBFILE_PRIORITY_meta-kmods = "6"

LAYERDEPENDS_meta-kmods = "core"
LAYERSERIES_COMPAT_meta-kmods = "dunfell"
```

## yocto/qemuarm64_demos_builddir/meta-myapps/conf/layer.conf
```bitbake
# We have a conf and classes directory, add to BBPATH
BBPATH .= ":${LAYERDIR}"

# We have recipes-* directories, add to BBFILES
BBFILES += "${LAYERDIR}/recipes-*/*/*.bb \
            ${LAYERDIR}/recipes-*/*/*.bbappend"

BBFILE_COLLECTIONS += "meta-myapps"
BBFILE_PATTERN_meta-myapps = "^${LAYERDIR}/"
BBFILE_PRIORITY_meta-myapps = "6"

LAYERDEPENDS_meta-myapps = "core"
LAYERSERIES_COMPAT_meta-myapps = "dunfell"
```

## yocto/qemuarm64_demos_builddir/meta-psplash/conf/layer.conf
```bitbake
# We have a conf and classes directory, add to BBPATH
BBPATH .= ":${LAYERDIR}"

# We have recipes-* directories, add to BBFILES
BBFILES += "${LAYERDIR}/recipes-*/*/*.bb \
            ${LAYERDIR}/recipes-*/*/*.bbappend"

BBFILE_COLLECTIONS += "meta-psplash"
BBFILE_PATTERN_meta-psplash = "^${LAYERDIR}/"
BBFILE_PRIORITY_meta-psplash = "6"

LAYERDEPENDS_meta-psplash = "core"
LAYERSERIES_COMPAT_meta-psplash = "dunfell"
```

## yocto/qemuarm_demos_builddir/conf/bblayers.conf
```bitbake
# POKY_BBLAYERS_CONF_VERSION is increased each time build/conf/bblayers.conf
# changes incompatibly
POKY_BBLAYERS_CONF_VERSION = "2"

BBPATH = "${TOPDIR}"
BBFILES ?= ""

BBLAYERS ?= " \
  /big/yocto_qarm64_nov22/poky/meta \
  /big/yocto_qarm64_nov22/poky/meta-poky \
  /big/yocto_qarm64_nov22/poky/meta-yocto-bsp \
  /big/yocto_qarm64_nov22/poky/meta-openembedded/meta-oe \
  /big/yocto_qarm64_nov22/poky/build_qemuarm64/meta-myprj \
  /big/yocto_qarm64_nov22/poky/build_qemuarm64/meta-helloworld \
  /big/yocto_qarm64_nov22/poky/build_qemuarm64/meta-autotools-helloworld \
  "
```

## yocto/qemuarm_demos_builddir/meta-hellowworld/conf/layer.conf
```bitbake
# We have a conf and classes directory, add to BBPATH
BBPATH .= ":${LAYERDIR}"

# We have recipes-* directories, add to BBFILES
BBFILES += "${LAYERDIR}/recipes-*/*/*.bb \
${LAYERDIR}/recipes-*/*/*.bbappend"

BBFILE_COLLECTIONS += "hellowworld"
BBFILE_PATTERN_hellowworld = "^${LAYERDIR}/"
BBFILE_PRIORITY_hellowworld = "10"

LAYER_DEPENDS_hellowworld = "core"
## TIP: UPDATE with later Yocto release names!
# ref: https://wiki.yoctoproject.org/wiki/Releases
# FIXME :: UPDATE the release names as required!
LAYERSERIES_COMPAT_hellowworld = "honister dunfell hardknott"
```

## yocto/qemuarm_demos_builddir/meta-kmods/conf/layer.conf
```bitbake
# We have a conf and classes directory, add to BBPATH
BBPATH .= ":${LAYERDIR}"

# We have recipes-* directories, add to BBFILES
BBFILES += "${LAYERDIR}/recipes-*/*/*.bb \
	${LAYERDIR}/recipes-*/*/*.bbappend"

BBFILE_COLLECTIONS += "kmods"
BBFILE_PATTERN_kmods = "^${LAYERDIR}/"
BBFILE_PRIORITY_kmods = "7"

LAYER_DEPENDS_kmods = "core"

# update as required
LAYERSERIES_COMPAT_kmods = "dunfell"
#LAYERSERIES_COMPAT_kmods = "warrior"
```

## yocto/rpi64_demos_builddir/meta-systemd-net/conf/layer.conf
```bitbake
# We have a conf and classes directory, add to BBPATH
BBPATH .= ":${LAYERDIR}"

# We have recipes-* directories, add to BBFILES
BBFILES += "${LAYERDIR}/recipes-*/*/*.bb \
            ${LAYERDIR}/recipes-*/*/*.bbappend"

BBFILE_COLLECTIONS += "meta-systemd-net"
BBFILE_PATTERN_meta-systemd-net = "^${LAYERDIR}/"
BBFILE_PRIORITY_meta-systemd-net = "16"

LAYERDEPENDS_meta-systemd-net = "core"
LAYERSERIES_COMPAT_meta-systemd-net = "honister hardknott gatesgarth kirkstone"
```
